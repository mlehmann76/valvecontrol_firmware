## main/Kconfig
```kconfig
menu "OutPut Configuration"

config CHANOUTPUT1
    int "Chan1"
    default "16"
config CHANOUTPUT2
    int "Chan2"
    default "17"
config CHANOUTPUT3
    int "Chan3"
    default "18"
config CHANOUTPUT4
    int "Chan4"
    default "19"
    
config CHANOUT_USE_PWM
    bool "Use Pwm on Outputs"
    default n

config CHANOUT_PWM_FREQ
    int "PWM Freq"
    depends on CHANOUT_USE_PWM
    default 50
    range 10 1000

config CHANOUT_PWM_DUTY
    int "PWM Duty"
    depends on CHANOUT_USE_PWM
    default 50
    range 5 100
   

endmenu
```

## main/Kconfig.projbuild
```kconfig
menu "WiFi Configuration"

config WIFI_SSID
    string "WiFi SSID"
	default "myssid"
	help
		SSID (network name) for the example to connect to.

config WIFI_PASSWORD
    string "WiFi Password"
	default "myssid"
	help
		WiFi password (WPA or WPA2) for the example to use.

		Can be left blank if the network has no security set.
endmenu

menu "WPS mode Configuration"

choice EXAMPLE_WPS_TYPE
    prompt "WPS mode"
    default EXAMPLE_WPS_TYPE_PBC
    help
	WPS type for the esp32 to use.

config EXAMPLE_WPS_TYPE_PBC
    bool "PBC"
config EXAMPLE_WPS_TYPE_PIN
    bool "PIN"
config EXAMPLE_WPS_TYPE_DISABLE
    bool "disable"
endchoice

endmenu

menu "OutPut Configuration"

config CHANOUTPUT1
    int "Chan1"
    default "16"
config CHANOUTPUT2
    int "Chan2"
    default "17"
config CHANOUTPUT3
    int "Chan3"
    default "18"
config CHANOUTPUT4
    int "Chan4"
    default "19"
    
config CHANOUT_USE_PWM
    bool "Use Pwm on Outputs"
    default n

config CHANOUT_PWM_FREQ
    int
    depends on CHANOUT_USE_PWM
    default 50

config CHANOUT_PWM_DUTY
    int
    depends on CHANOUT_USE_PWM
    default 50
    

endmenu
```
